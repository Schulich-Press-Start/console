## tests/lib/custom/testcase.yaml
```yaml
common:
  tags: extensibility
  integration_platforms:
    - native_sim
tests:
  lib.custom: {}
  lib.custom.non_default:
    extra_args: CONFIG_CUSTOM_GET_VALUE_DEFAULT=6
```
