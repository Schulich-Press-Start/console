## CMakeLists.txt
```
#-------------------------------------------------------------------------------
# SPS console app, based on Zephyr's example-application template
#
# Copyright (c) 2021 Nordic Semiconductor ASA
# SPDX-License-Identifier: Apache-2.0

cmake_minimum_required(VERSION 3.13.1)
find_package(Zephyr REQUIRED HINTS $ENV{ZEPHYR_BASE})

project(app LANGUAGES C)

target_sources(app PRIVATE src/main.c)

# The code below locates the git index file for this repository and adds it as a dependency for
# the application VERSION file so that if the repo has a new commit added, even if no files in
# the build have changed, the application version file will be regenerated with the new git commit
find_package(Git QUIET)
if(GIT_FOUND)
  execute_process(
    COMMAND ${GIT_EXECUTABLE} rev-parse --absolute-git-dir
    WORKING_DIRECTORY .
    OUTPUT_VARIABLE application_git_dir
    OUTPUT_STRIP_TRAILING_WHITESPACE
    ERROR_STRIP_TRAILING_WHITESPACE
    ERROR_VARIABLE stderr
    RESULT_VARIABLE return_code
  )
  # If there is an error e.g. it is not a git repo, we just silently ignore it and continue
  # without a dependency, this will be the case with freestanding applications.
  if(NOT return_code)
    if(NOT "${stderr}" STREQUAL "")
      message(WARNING "Application build version git rev-parse warned: ${stderr}")
    endif()

    set_property(TARGET app_version_h PROPERTY APP_VERSION_DEPENDS ${application_git_dir}/index)
  endif()
endif()
```

## sample.yaml
```
# Lets Twister, Zephyr's test runner, build the app. CI builds every scenario
# below on both integration platforms. Zephyr v4.4 only looks for sample.yaml
# and testcase.yaml, so keep these names until we move past it.
sample:
  description: SPS console firmware
  name: console
common:
  build_only: true
  integration_platforms:
    - nucleo_h755zi_q/stm32h755xx/m7
    - native_sim
tests:
  app.default: {}
  app.debug:
    extra_overlay_confs:
      - debug.conf
```

## prj.conf
```kconfig
# Kconfig options for the console app.
# hello world needs nothing extra yet. add options here as the app grows.
```

## src/main.c
```c
/*
 * SPS console firmware.
 *
 * SPDX-License-Identifier: Apache-2.0
 */

#include <stdio.h>

#include <zephyr/kernel.h>
#include <zephyr/app_version.h>

int main(void)
{
	/* hello world for now. the 32blit platform port takes over this file later */
	printf("SPS console %s: hello from %s\n", APP_VERSION_STRING, CONFIG_BOARD_TARGET);

	return 0;
}
```
